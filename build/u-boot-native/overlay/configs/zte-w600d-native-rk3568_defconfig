## build/u-boot-native/overlay/configs/zte-w600d-native-rk3568_defconfig
```kconfig
CONFIG_ARM=y
CONFIG_SKIP_LOWLEVEL_INIT=y
CONFIG_COUNTER_FREQUENCY=24000000
CONFIG_ARCH_ROCKCHIP=y
CONFIG_DEFAULT_DEVICE_TREE="rk3568-w600d-native"
CONFIG_ROCKCHIP_RK3568=y
CONFIG_TEXT_BASE=0x00800000
CONFIG_SYS_LOAD_ADDR=0x02000000
CONFIG_DEBUG_UART_BASE=0xFE660000
CONFIG_DEBUG_UART_CLOCK=24000000
CONFIG_DEBUG_UART=y
CONFIG_SYS_MEM_TOP_HIDE=0x2100000
CONFIG_LOCALVERSION="-w600d-native-experimental"
CONFIG_FIT=y
CONFIG_LEGACY_IMAGE_FORMAT=y
CONFIG_BOOTSTD=y
CONFIG_BOOTSTD_FULL=y
# CONFIG_BOOTSTD_DEFAULTS is not set
# CONFIG_BOOTMETH_DISTRO is not set
CONFIG_BOOTMETH_EXTLINUX=y
# CONFIG_BOOTMETH_SCRIPT is not set
# CONFIG_BOOTMETH_EFILOADER is not set
# CONFIG_BOOTMETH_VBE is not set
CONFIG_BOOTDELAY=10
CONFIG_USE_BOOTCOMMAND=y
CONFIG_BOOTCOMMAND="bootflow scan -b usb"
CONFIG_USE_PREBOOT=y
CONFIG_PREBOOT="usb start; setenv boot_targets usb; setenv stdin serial,usbkbd; setenv stdout serial,vidconsole; setenv stderr serial,vidconsole; echo W600D native-display experiment - USB only"
CONFIG_DEFAULT_FDT_FILE="rockchip/rk3568-zte-w600d-mainline-v6-wifi-bt.dtb"
# CONFIG_DISPLAY_CPUINFO is not set
CONFIG_DISPLAY_BOARDINFO_LATE=y
CONFIG_CMD_BOOTI=y
CONFIG_CMD_BOOTFLOW=y
CONFIG_CMD_GPIO=y
CONFIG_CMD_USB=y
CONFIG_CMD_FS_GENERIC=y
CONFIG_CMD_PART=y
CONFIG_CMD_FAT=y
CONFIG_CMD_EXT4=y
CONFIG_CMD_REGULATOR=y
CONFIG_CMD_DM=y
CONFIG_CMD_FDT=y
CONFIG_OF_LIVE=y
# CONFIG_OF_UPSTREAM is not set
# CONFIG_ARCH_FIXUP_FDT_MEMORY is not set
CONFIG_ENV_IS_NOWHERE=y
CONFIG_NO_NET=y
# CONFIG_MMC is not set
# CONFIG_CMD_MMC is not set
# CONFIG_SCSI is not set
# CONFIG_SPI_FLASH is not set
# CONFIG_SPI is not set
# CONFIG_ROCKCHIP_SPI_IMAGE is not set
# CONFIG_CMD_SF is not set
# CONFIG_CMD_FLASH is not set
# CONFIG_CMD_SAVEENV is not set
# CONFIG_MTD is not set
# CONFIG_EFI_LOADER is not set
# CONFIG_USB_GADGET is not set
# CONFIG_ADC is not set
# CONFIG_ROCKCHIP_IODOMAIN is not set
CONFIG_GPIO_HOG=y
CONFIG_ROCKCHIP_GPIO=y
CONFIG_MISC=y
CONFIG_PHY_ROCKCHIP_INNO_USB2=y
CONFIG_PHY_ROCKCHIP_NANENG_COMBOPHY=y
CONFIG_DM_REGULATOR_FIXED=y
CONFIG_BAUDRATE=115200
CONFIG_DEBUG_UART_SHIFT=2
CONFIG_SYS_NS16550_MEM32=y
CONFIG_SYSRESET=y
CONFIG_SYSRESET_PSCI=y
CONFIG_USB=y
CONFIG_USB_XHCI_HCD=y
CONFIG_USB_EHCI_HCD=y
CONFIG_USB_EHCI_GENERIC=y
CONFIG_USB_OHCI_HCD=y
CONFIG_USB_OHCI_GENERIC=y
CONFIG_USB_DWC3=y
CONFIG_USB_DWC3_GENERIC=y
CONFIG_USB_STORAGE=y
CONFIG_USB_KEYBOARD=y
CONFIG_VIDEO=y
CONFIG_VIDEO_ROCKCHIP=y
CONFIG_DISPLAY_ROCKCHIP_EDP=y
CONFIG_DISPLAY=y
CONFIG_VIDEO_W600D_NATIVE=y
CONFIG_BACKLIGHT_PWM=y
CONFIG_PWM_ROCKCHIP=y
# CONFIG_VIDEO_LOGO is not set
# CONFIG_VIDEO_FONT_8X16 is not set
CONFIG_VIDEO_FONT_16X32=y
CONFIG_SYS_WHITE_ON_BLACK=y
CONFIG_ERRNO_STR=y
CONFIG_FS_FAT=y
CONFIG_FS_EXT4=y
# CONFIG_FAT_WRITE is not set
# CONFIG_EXT4_WRITE is not set
```
