#include "rk3568-zte-w600d-mainline-v2.dts"

&pmu_io_domains {
	pmuio2-supply = <&vcc3v3_pmu>;
	vccio5-supply = <&vcc_3v3>;
	vccio6-supply = <&vcc_3v3>;
	vccio7-supply = <&vcc_3v3>;
};

&vop {
	assigned-clocks = <&cru PLL_VPLL>, <&cru DCLK_VOP1>;
	assigned-clock-parents = <0>, <&cru PLL_VPLL>;
	assigned-clock-rates = <564080000>, <141020000>;
};
